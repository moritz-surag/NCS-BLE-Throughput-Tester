## debug/Kconfig/Kconfig.shield
```kconfig
osource "/Users/moritz/Library/CloudStorage/OneDrive-SURAGMedicalGmbH/Coding/nRF_Boards/boards/shields/*/Kconfig.shield"
osource "/Users/moritz/Library/CloudStorage/OneDrive-SURAGMedicalGmbH/Coding/NCS-BLE-Throughput-Tester/boards/shields/*/Kconfig.shield"
osource "/opt/nordic/ncs/v2.5.1/nrf/boards/shields/*/Kconfig.shield"
```

## debug/Kconfig/Kconfig.shield.defconfig
```kconfig
osource "/Users/moritz/Library/CloudStorage/OneDrive-SURAGMedicalGmbH/Coding/nRF_Boards/boards/shields/*/Kconfig.defconfig"
osource "/opt/nordic/ncs/v2.5.1/nrf/boards/shields/*/Kconfig.defconfig"
```
